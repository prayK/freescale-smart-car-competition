#include "common.h"
#include "include.h"
#include "math.h"
#include "SmartCarControl.h"

/*直接空PWM来控速度*/
extern int8      CurrentError;  
extern int8      LargeCornerint8, BigSFlag;
extern uint8     Ring_Find_Flag, LeftRing_Find_Flag ; 

int16   PulseCount = 0;
uint32  speed_line[2]; 

volatile uint16 GoalSpeed = 0; 
float    Speed_Kp = 0.6,
          Speed_Ki = 0.1,
          Speed_Kd = 0;

uint16    DutyGo = 0; 
uint16    DutyBack = 0; 
 
int16     SpeedOutPut = 0; 

int16      EC_num = 0, 
           Speed_Ek0 = 0, 
           Speed_Ek1 = 0, 
           Speed_Ek2 = 0;
 
int16  S_Error;
float a,b;
extern uint8 ave_center_s,ave_center;


/***读出编码器反馈的速度***/
void EncoderRead(void) 
{ 
             PulseCount = ftm_quad_get(FTM1); 
             //PulseCount = - PulseCount; 
             if(PulseCount < 0) PulseCount = 0; 
             ftm_quad_clean(FTM1); 
} 
 
extern int8 CurrentError; 
extern float bian_bi,bian_ca;
float  speed_low = 210,
        speed_high = 250; 

extern uint8  Ring_Find_Flag; 
extern uint8  LeftRing_Find_Flag;
extern uint8  RightRing_Find_Flag;
extern uint8  assist1; 
extern uint8  UFlag;
extern Site_t center_line[60]; 
extern uint8  shi_flag; 
uint8 LittleSFlag = 0;

int16 GoalSpeedSet(void)
{
      S_Error = ave_center_s - 40;

      if(S_Error < 0)  S_Error = -S_Error;
      if(S_Error > 20) S_Error = 20; //将速度偏差限定在0到20之间
 
//      if(BM4==1) 
//      { 
            a = sqrt((speed_high - speed_low) / 400);
            b = speed_low;
            GoalSpeed = (uint16)((a * (S_Error - 20)) * (a * (S_Error - 20)) + b); //速度方案一 // speed=(a*（S_Error-20）)^2+b;
//      } 
//      if(BM4==0) 
//      {  
//            a = (speed_high - speed_low) / 20; 
//            b = speed_high; 
//            GoalSpeed = (uint16)( -a * S_Error + b); //速度方案二 //speed=-a*S_Error + b
//      } 
 
     if (Ring_Find_Flag == 1) 
     //if (assist1 == 1) 
     { 
            GoalSpeed = 160;
     } 
     
//     if (shi_flag == 1) //十字接Q弯，所以减速
//     {  
//            GoalSpeed = 160;
//            led(LED3, LED_ON); 
//     } 
//     if (    abs (center_line[MostEndLine].x - 40) > 5
//          && abs (center_line[LittleEndLine].x - 40) < 3 
//          &&(center_line[MiddleLine].x == 0)
//          &&(center_line[LittleTopLine].x == 0)
//          &&(center_line[TopLine].x == 0))//入弯十字准确判别
//     { 
//            GoalSpeed = 150;//方向脉冲
//            UFlag = 1;
//            led(LED3, LED_ON); 
//     } 
     if (abs(ave_center - 40) < 4
       && abs(center_line[EndLine].x - 40) < 5
       && abs(center_line[LittleEndLine].x - 40) < 5
       && abs(center_line[MiddleLine].x - 40) < 5
       && abs(center_line[LittleTopLine].x - 40) < 5
       && abs(center_line[TopLine].x - 40) < 5
       && Ring_Find_Flag == 0
         )////////////////直线或者小S直冲
     {
           GoalSpeed = 360;
           LittleSFlag = 1;
           
     }
     
      if ((center_line[LittleEndLine].x < 38 && center_line[EndLine].x == 0) 
            &&(center_line[LittleTopLine].x != 0 && center_line[TopLine].x != 0) ///左转 
            &&(center_line[MiddleLine].x != 0) 
            &&(shi_flag != 1)
            &&(Ring_Find_Flag == 0)
          )//U型
          {
                   GoalSpeed = 270;
          } 

          if ((center_line[LittleEndLine].x > 42 && center_line[EndLine].x == 0) 
            &&(center_line[LittleTopLine].x != 0 && center_line[TopLine].x != 0)///右转 
            &&(center_line[MiddleLine].x != 0)
            &&(shi_flag != 1)
            && Ring_Find_Flag == 0
            )//U型
          { 
                    GoalSpeed = 270;
          } 
     
     if((GoalSpeed - (uint16)speed_low) > (uint16)((speed_high - speed_low) * bian_bi)) //计算速度时 防止弯道大幅度加速  根据扫描到的行数来确定速度 
     {
           GoalSpeed = (uint16)((speed_high - speed_low) * bian_bi + speed_low); //纵向弯道限幅
     }
  
     if((GoalSpeed - (uint16)speed_low) > (uint16)((speed_high - speed_low) * bian_ca)) //横向弯道限幅
     {
          GoalSpeed = (uint16)((speed_high - speed_low) * bian_ca + speed_low); 
     }
      return GoalSpeed;
}

/***电机pid输出速度***/ 
void MotorControl(void) 
{ 
          Speed_Ek0 = GoalSpeed - PulseCount; 
 
          SpeedOutPut= (int16) (   SpeedOutPut
                                   + (int16)(Speed_Kp * (Speed_Ek0 - Speed_Ek1)) 
                                   + (int16)(Speed_Ki * (Speed_Ek0)) 
                                   + (int16)(Speed_Kd * (Speed_Ek0 - 2 * Speed_Ek1 + Speed_Ek2)) 
                                ); 
          Speed_Ek2 = Speed_Ek1; 
          Speed_Ek1 = Speed_Ek0; 

          if ( SpeedOutPut > 60 ) SpeedOutPut  = 60; 
          else if ( SpeedOutPut < (int16) -60 ) SpeedOutPut = -60; 
 
          if(SpeedOutPut > 0) 
          { 
                  DutyGo = (uint16)SpeedOutPut;
                  DutyBack = 0; 
          } 
          else 
          { 
                  DutyGo = 0; 
                  DutyBack = (uint16)(-SpeedOutPut); 
          } 
          ftm_pwm_duty(FTM0, FTM_CH2, (uint16)DutyGo);
          ftm_pwm_duty(FTM0, FTM_CH3, (uint16)DutyBack); 
          
      #if (0)
          speed_line[0] = (uint32)PulseCount; 
          speed_line[1] = (uint32)GoalSpeed;
          vcan_sendware(speed_line, sizeof(speed_line));
      #endif
} 
 
uint8 DisPlay_BMP[11520] = {
0X2D,0X2D,0X2D,0X2D,0X2D,0X2D,0X2D,0X2D,0X2C,0X2D,0X2D,0X2D,0X2D,0X2E,0X2C,0X2C,
0X2D,0X2E,0X2E,0X2E,0X2D,0X2C,0X2D,0X2D,0X2D,0X2F,0X2D,0X2E,0X2F,0X2F,0X2E,0X2E,
0X2E,0X2F,0X30,0X2F,0X2F,0X30,0X2F,0X30,0X31,0X31,0X31,0X32,0X34,0X35,0X37,0X39,
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0X2E,0X2F,0X30,0X2F,0X2F,0X2E,0X2F,0X31,0X30,0X30,0X31,0X31,0X2F,0X30,0X31,0X31,
};


extern uint8   CNST_Value;
extern uint8   ave_center; 
extern uint8   img[60][CAMERA_W]; 
extern Site_t  Center_Line[60]; 
extern Site_t  Center_Line_F[60]; 
extern Site_t  sit_L[60]; 
extern Site_t  sit_R[60];  
extern Site_t  center_line[60]; 
extern float  ServoOutPut; 

extern uint8_t left_lost, 
                right_lost;

extern uint8_t h_left_lost, 
                h_right_lost;

uint8   h_left_lost_Dis = 0,
        h_right_lost_Dis = 0,
        right_lost_Dis = 0,
        left_lost_Dis = 0;
            
void LostFlagDisplay(void)
{
       if (h_left_lost == 1)  h_left_lost_Dis = 1;
       else  h_left_lost_Dis = 0;
       
       if (h_right_lost == 1)  h_right_lost_Dis = 1;
       else  h_right_lost_Dis = 0;
       
       if (left_lost == 1)  left_lost_Dis = 1;
       else  left_lost_Dis = 0;
       
       if (right_lost == 1)  right_lost_Dis = 1;
       else  right_lost_Dis = 0;
       
}

/***TFT显示信息++*/
void ImageWatching(void)
{
       if (BM1 == 1) 
       {
                  ImageIdentification(); //图像处理
                  LostFlagDisplay();
                  
                  /*显示图像和三条边线*/
                  Site_t Site = {0, 0}; 
                  Size_t Size = {80, 60}; 
                  lcd_img_gray(Site, Size, img[0]); 
                  lcd_points(center_line, 60, BLUE); 
                  lcd_points(sit_R, 60, GREEN); 
                  lcd_points(sit_L, 60, BRED); 
                  
                  /*把四条线和前瞻画出来*/
                  Site_t SiteCrossEndLine = {0, EndLine};      // 38
                  Site_t SiteCrossLittleEndLine = {0, LittleEndLine};//43
                  Site_t SiteCrossMiddleLine = {0, MiddleLine};   // 48
                  Site_t SiteCrossLittleTopLine = {0, LittleTopLine};// 53
                  Site_t SiteCrossTopLine = {0, TopLine};      // 58
                  
                  lcd_cross (SiteCrossEndLine, 160, RED);
                  lcd_cross (SiteCrossLittleEndLine, 160, RED);
                  lcd_cross (SiteCrossMiddleLine, 160, RED);
                  lcd_cross (SiteCrossLittleTopLine, 160, RED);
                  lcd_cross (SiteCrossTopLine, 160, RED);
                  
//                  Site_t SiteCrossQZ_End = {0, QZ_End}; 
//                  Site_t SiteCrossQZ_Top = {0, QZ_Top}; 
//                  lcd_cross (SiteCrossQZ_End, 160, GREEN);
//                  lcd_cross (SiteCrossQZ_Top, 160, GREEN);
                  

                  /*显示平均中值和四行的中值*/
                  Site_t SiteDis_CenterStr = {80, 0};
                  Site_t SiteDis_CenterNum = {80, 16};
                  lcd_str(SiteDis_CenterStr,"S_M:", BLACK, WHITE);
                  lcd_num_bc(SiteDis_CenterNum, ave_center, 4, BLACK, WHITE);
                  
                  
                  Site_t SiteTopStr = {80, 32}; 
                  Site_t SiteTopNum = {80, 48};
                  lcd_str(SiteTopStr,"Top:", BLACK, WHITE);
                  lcd_num_bc(SiteTopNum, center_line[TopLine].x, 4, BLACK, WHITE);
                  
                  Site_t SiteLTopStr= {80, 64}; 
                  Site_t SiteLTopNum = {80, 80}; 
                  lcd_str(SiteLTopStr,"LTop:", BLACK, WHITE);
                  lcd_num_bc(SiteLTopNum, center_line[LittleTopLine].x, 4, BLACK, WHITE); 
                  
                  Site_t SiteMiddleStr= {80, 96}; 
                  Site_t SiteMiddleNum = {80, 112};
                  lcd_str(SiteMiddleStr,"Mid:", BLACK, WHITE);
                  lcd_num_bc(SiteMiddleNum, center_line[MiddleLine].x, 4, BLACK, WHITE);
                  
                  Site_t SiteLEndStr= {36, 64}; 
                  Site_t SiteLEndNum = {36, 80};
                  lcd_str(SiteLEndStr,"LEND:", BLACK, WHITE);
                  lcd_num_bc(SiteLEndNum, center_line[LittleEndLine].x, 4, BLACK, WHITE);
                  
                  Site_t SiteEndStr= {36, 96}; 
                  Site_t SiteEndNum = {36, 112};
                  lcd_str(SiteEndStr,"END:", BLACK, WHITE);
                  lcd_num_bc(SiteEndNum, center_line[EndLine].x, 4, BLACK, WHITE);
                  
 
                  /*显示前五行左右有没有丢线*/
                  Site_t Siteh_left_lost_DisStr= {0, 96}; 
                  Site_t Siteh_left_lost_DisNum = {0, 112};
                  lcd_str(Siteh_left_lost_DisStr,"HL:", BLACK, WHITE);
                  lcd_num_bc(Siteh_left_lost_DisNum, h_left_lost_Dis, 4, BLACK, WHITE);
                  
                  Site_t Siteh_right_los_DisStr= {0, 64}; 
                  Site_t Siteh_right_los_DisNum = {0, 80};
                  lcd_str(Siteh_right_los_DisStr,"HR:", BLACK, WHITE);
                  lcd_num_bc(Siteh_right_los_DisNum, h_right_lost_Dis, 4, BLACK, WHITE);
       }
 
       else if (BM1 == 0)
       {
                  Site_t SiteZB1 = {91,  0}; 
                  Site_t SiteZB2 = {91, 16}; 
                  Site_t SiteZB3 = {91, 32}; 
                  Site_t SiteZB4 = {91, 48}; 
                  Site_t SiteZB5 = {91, 64};
                  Site_t SiteZB6 = {91, 80}; 
                  Site_t SiteZB7 = {91, 96}; 

                  Site_t SiteZB8 = {107,  0}; 
                  Site_t SiteZB9 = {107, 16}; 
                  Site_t SiteZB10 = {107, 32}; 
                  Site_t SiteZB11 = {107, 48};
                  Site_t SiteZB12 = {107, 64}; 
                  Site_t SiteZB13 = {107, 80}; 

                  lcd_str_ench(SiteZB1, "车", BRED, GRED); 
                  lcd_str_ench(SiteZB2, "子", BRED, GRED); 
                  lcd_str_ench(SiteZB3, "不", BRED, GRED); 
                  lcd_str_ench(SiteZB4, "一", BRED, GRED); 
                  lcd_str_ench(SiteZB5, "定", BRED, GRED); 
                  lcd_str_ench(SiteZB6, "要", BRED, GRED); 
                  lcd_str_ench(SiteZB7, "快", BRED, GRED); 
 
                  lcd_str_ench(SiteZB8, "但", BRED, GRED); 
                  lcd_str_ench(SiteZB9, "是", BRED, GRED); 
                  lcd_str_ench(SiteZB10, "一", BRED, GRED); 
                  lcd_str_ench(SiteZB11, "定", BRED, GRED); 
                  lcd_str_ench(SiteZB12, "要", BRED, GRED); 
                  lcd_str_ench(SiteZB13, "骚", BRED, GRED); 

                  Site_t site = { 0,   0}; 
                  Size_t size = {90, 128};

                  lcd_img_gray(site, size, DisPlay_BMP); 
       }
}
